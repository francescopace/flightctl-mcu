## firmware/main/Kconfig.projbuild
```kconfig
menu "flightctl-mcu"

# The settings below are defaults for development. A device takes them from
# its fc_creds partition (deploy/provision.sh) when they are there.

config FC_WIFI_SSID
    string "WiFi SSID"
    default ""
    help
        Set it in sdkconfig.wifi (git-ignored), not in sdkconfig.defaults,
        or provision it.

config FC_WIFI_PASSWORD
    string "WiFi password"
    default ""

config FC_SERVER_HOST
    string "Flight Control agent endpoint host"
    default ""
    help
        Set it in sdkconfig.local (git-ignored), e.g.
        CONFIG_FC_SERVER_HOST="agent-api.<your-ip>.nip.io".
        deploy/enrollment.sh prints the endpoint of your server.

config FC_SERVER_PORT
    int "Flight Control agent endpoint port"
    default 8443

config FC_OTA_VERIFY_TIMEOUT
    int "Seconds a new firmware has to reach Flight Control before rollback"
    default 150
    help
        Counted from the boot into the new image. The rollback test build
        (sdkconfig.broken) shortens it.

config FC_TEST_SERVER_PORT
    int "Test only: force this agent endpoint port (0: off)"
    default 0
    help
        Used by the rollback test (sdkconfig.broken): a firmware that cannot
        reach Flight Control whatever the device was provisioned with.

config FC_LABELS
    string "Enrollment labels (k=v,k=v)"
    default "site=lab,app=alarm"

config FC_STATUS_INTERVAL
    int "Status update interval (s)"
    default 120
    help
        Changes are reported right away; this is the heartbeat. Flight
        Control marks a device Unknown after 5 minutes without a status, so
        keep it well below 300.

config FC_LED_GPIO
    int "Default LED GPIO (overridable from config)"
    default 48
    help
        ESP32-S3-DevKitC-1 v1.0: 48, v1.1: 38. The fleet config field
        led_gpio overrides it at runtime.

config FC_LED_WS2812
    bool "LED is a WS2812 (addressable RGB)"
    default y

config FC_FIELD_PROVISIONING
    bool "WiFi provisioning in the field (SoftAP)"
    default y
    help
        A device provisioned without WiFi but with a proof of possession
        (deploy/provision.py --pop) opens an access point where an installer
        gives it the site's network (esp_prov, or Espressif's provisioning
        app). Security 1 with the proof of possession. See
        docs/PROVISIONING.md.

config FC_FIELD_PROVISIONING_BLE
    bool "Field provisioning over BLE instead of SoftAP"
    depends on FC_FIELD_PROVISIONING && BT_NIMBLE_ENABLED
    default y
    help
        Set by the ble variant (firmware/sdkconfig.ble), which turns on
        NimBLE. The Bluetooth memory is freed once the device has a network.

config FC_DEVICE_KEY_DS
    bool "Device key in the Digital Signature peripheral (burns an eFuse key block)"
    depends on SOC_DIG_SIGN_SUPPORTED
    default n
    help
        The device key is RSA, generated on the first boot and sealed into
        the DS peripheral: its parameters are encrypted with an HMAC key
        burned into a free eFuse key block, which software cannot read.
        Each new device key (first boot, re-enrollment) takes one key block
        for good; with none left, the key stays in storage. Off: Flight
        Control 1.3.1 cannot issue a certificate for an RSA key (its CA
        copies the request's signature algorithm, and the CA key is ECDSA).

config FC_DEVICE_KEY_DS_BITS
    int "Device key size (RSA bits)"
    depends on FC_DEVICE_KEY_DS
    range 2048 4096
    default 3072

endmenu
```
