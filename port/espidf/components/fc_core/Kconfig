## port/espidf/components/fc_core/Kconfig
```kconfig
menu "flightctl-mcu tests"

config FC_TEST_FAULT_AFTER_S
    int "Test only: fault on purpose this many seconds after a boot that was not a crash (0: off)"
    default 0
    help
        For the test of lastFatalError (sdkconfig.faulttest,
        tests/e2e/fatal-emu.sh): a task named fc_fault writes to address 0,
        once per power-on. Never in a release.

choice FC_TEST_FAULT_KIND
    prompt "Test only: the fault"
    depends on FC_TEST_FAULT_AFTER_S > 0
    default FC_TEST_FAULT_STORE

config FC_TEST_FAULT_STORE
    bool "A write to address 0"

config FC_TEST_FAULT_ABORT
    bool "abort(), as a failed assert makes"
    help
        sdkconfig.aborttest, with sdkconfig.faulttest.

config FC_TEST_FAULT_IWDT
    bool "A loop with interrupts off: the interrupt watchdog's panic"
    help
        sdkconfig.iwdttest, with sdkconfig.faulttest.

config FC_TEST_FAULT_TWDT
    bool "A loop above the idle task: the task watchdog's panic"
    help
        sdkconfig.twdttest, with sdkconfig.faulttest: the task watchdog
        set to panic, which it is not by default.

endchoice

endmenu
```

## port/nuttx/Kconfig
```kconfig
config FLIGHTCTL
	bool "Flight Control MCU agent"
	default n

config FLIGHTCTL_SERIAL_NETWORK
	bool "Use IPv4 SLIP over a debug probe UART"
	depends on FLIGHTCTL && NET_SLIP && NETDB_DNSCLIENT
	help
	  Reserve the UART for the link to stlink-network.py --link ipv4.
	  The peer supplies DNS and routes traffic to Flight Control.

config FLIGHTCTL_SLIP_DEVICE
	string "Dedicated SLIP serial device"
	depends on FLIGHTCTL_SERIAL_NETWORK
	default "/dev/ttyS0"

config FLIGHTCTL_NRF7002DK
	bool "nRF7002 DK with network-core entropy and temperature"
	depends on ARCH_BOARD_NRF5340_DK
	select ARCH_HAVE_RNG
```

## port/zephyr/boards/esp32s3_mini_n4r2.conf
```kconfig
CONFIG_SPIRAM_MODE_QUAD=y
CONFIG_ESP_SPIRAM_HEAP_SIZE=1048576
CONFIG_FC_FW_PLATFORM="esp32s3-mini-n4r2"
```

## port/zephyr/boards/nrf7002dk_nrf5340_cpuapp.conf
```kconfig
CONFIG_WIFI=y
CONFIG_NET_MGMT=y
CONFIG_NET_MGMT_EVENT=y
CONFIG_NET_DHCPV4=y
CONFIG_WIFI_NM_WPA_SUPPLICANT_LEGACY_CRYPTO=n
CONFIG_STREAM_FLASH=y
CONFIG_IMG_MANAGER=y
CONFIG_MCUBOOT_IMG_MANAGER=y
CONFIG_MCUBOOT_GENERATE_CONFIRMED_IMAGE=y
CONFIG_IMG_ERASE_PROGRESSIVELY=y
CONFIG_SPI=y
CONFIG_SPI_NOR=y
CONFIG_FS_LITTLEFS_PROG_SIZE=256
CONFIG_FS_LITTLEFS_CACHE_SIZE=256
CONFIG_FC_FW_PLATFORM="nrf7002dk_nrf5340_cpuapp"
# The network core supplies hardware entropy over the HCI IPC transport.
CONFIG_BT=y
CONFIG_BT_OBSERVER=y
CONFIG_MBEDTLS_PSA_CRYPTO_EXTERNAL_RNG_ALLOW_NON_CSPRNG=n
CONFIG_MBEDTLS_PSA_CRYPTO_EXTERNAL_RNG=y
CONFIG_MAX_PTHREAD_MUTEX_COUNT=40
CONFIG_HEAP_MEM_POOL_SIZE=73728
CONFIG_SENSOR=y
CONFIG_ADC=y
CONFIG_PWM=y
CONFIG_I2C=y
CONFIG_UART_INTERRUPT_DRIVEN=y
CONFIG_UART_USE_RUNTIME_CONFIGURE=y

CONFIG_FC_LIBC_HEAP_WATERMARK=y
```

## port/zephyr/boards/nucleo_f767zi.conf
```kconfig
CONFIG_CACHE_MANAGEMENT=y
CONFIG_NET_L2_ETHERNET=y
CONFIG_NET_DHCPV4=y
CONFIG_NET_CONFIG_SETTINGS=y
CONFIG_NET_CONFIG_NEED_IPV4=y
CONFIG_NET_CONFIG_INIT_TIMEOUT=15
CONFIG_STREAM_FLASH=y
CONFIG_IMG_MANAGER=y
CONFIG_MCUBOOT_IMG_MANAGER=y
CONFIG_MCUBOOT_GENERATE_CONFIRMED_IMAGE=y
CONFIG_IMG_ERASE_PROGRESSIVELY=y
CONFIG_MBEDTLS_PSA_CRYPTO_EXTERNAL_RNG=y
CONFIG_MBEDTLS_PSA_CRYPTO_EXTERNAL_RNG_ALLOW_NON_CSPRNG=n
CONFIG_GPIO=y
CONFIG_SENSOR=y
CONFIG_ADC=y
CONFIG_FILE_SYSTEM_LITTLEFS=n
CONFIG_SETTINGS=y
CONFIG_NVS=y
CONFIG_SETTINGS_NVS=y
CONFIG_SETTINGS_NVS_SECTOR_COUNT=2
CONFIG_FC_HEAP_SIZE=139264
CONFIG_HEAP_MEM_POOL_SIZE=90112
CONFIG_MAX_PTHREAD_MUTEX_COUNT=40
```

## port/zephyr/boards/nucleo_f767zi_stlink.conf
```kconfig
CONFIG_NET_DRIVERS=y
CONFIG_ETH_DRIVER=y
CONFIG_SLIP=y
CONFIG_SLIP_TAP=y
CONFIG_FC_FW_PLATFORM="nucleo_f767zi-stlink"
CONFIG_UART_CONSOLE=n
CONFIG_SLIP_MAC_ADDR="5a:94:ef:e4:0c:ee"
CONFIG_RAM_CONSOLE=y
CONFIG_RAM_CONSOLE_BUFFER_SIZE=4096
```
