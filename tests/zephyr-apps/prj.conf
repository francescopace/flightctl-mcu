## CMakeLists.txt
```
# The apps' C library on Zephyr: the apps' runtime (core/src/fc_apps.c) with
# the Zephyr port and its C library, as the firmware has them (port/zephyr's
# prj.conf and board files), without the agent. Built and run with
# tests/zephyr-apps.sh, on native_sim or mps2/an385 in QEMU. On ESP32-S3
# the same runtime runs the virtual button fixture (docs/TESTING.md).
cmake_minimum_required(VERSION 3.20)
set(ROOT ${CMAKE_CURRENT_LIST_DIR}/../..)
set(PORT ${ROOT}/port/zephyr)
# The firmware's configuration and devicetree, then this test's.
string(REPLACE "/" "_" FC_BOARD_FILE "${BOARD}")
set(CONF_FILE ${PORT}/prj.conf)
if(EXISTS ${PORT}/boards/${FC_BOARD_FILE}.conf)
    list(APPEND CONF_FILE ${PORT}/boards/${FC_BOARD_FILE}.conf)
endif()
list(APPEND CONF_FILE ${CMAKE_CURRENT_LIST_DIR}/prj.conf)
if(EXISTS ${PORT}/boards/${FC_BOARD_FILE}.overlay)
    set(DTC_OVERLAY_FILE ${PORT}/boards/${FC_BOARD_FILE}.overlay)
endif()
if(BOARD STREQUAL "esp32s3_devkitc/esp32s3/procpu")
    set(s3 esp32s3_devkitc_procpu)
    list(APPEND CONF_FILE ${CMAKE_CURRENT_LIST_DIR}/boards/${s3}.conf)
    set(DTC_OVERLAY_FILE ${PORT}/boards/${s3}.overlay ${CMAKE_CURRENT_LIST_DIR}/boards/${s3}.overlay)
endif()
list(APPEND DTS_ROOT ${PORT})
find_package(Zephyr REQUIRED HINTS $ENV{ZEPHYR_BASE})
project(fc_zephyr_apps)
zephyr_include_directories(${PORT}/include)

enable_language(ASM)
set(WAMR_BUILD_PLATFORM "zephyr")
if(CONFIG_ARCH_POSIX)
    if(CMAKE_HOST_SYSTEM_PROCESSOR MATCHES "^(arm64|aarch64)")
        set(WAMR_BUILD_TARGET "AARCH64")
    else()
        set(WAMR_BUILD_TARGET "X86_64")
    endif()
elseif(CONFIG_XTENSA)
    set(WAMR_BUILD_TARGET "XTENSA")
    target_include_directories(app PRIVATE ${ZEPHYR_BASE}/arch/xtensa/include)
elseif(CONFIG_CPU_CORTEX_M)
    set(WAMR_BUILD_TARGET "THUMBV7EM")
else()
    message(FATAL_ERROR "tests/zephyr-apps: unsupported WAMR target")
endif()
# As port/zephyr/CMakeLists.txt.
set(WAMR_BUILD_INTERP 1)
set(WAMR_BUILD_FAST_INTERP 1)
set(WAMR_BUILD_AOT 0)
set(WAMR_BUILD_JIT 0)
set(WAMR_BUILD_LIBC_BUILTIN 1)
set(WAMR_BUILD_LIBC_WASI 0)
set(WAMR_BUILD_SIMD 0)
set(WAMR_BUILD_REF_TYPES 0)
set(WAMR_BUILD_INSTRUCTION_METERING 1)
set(WAMR_BUILD_TAIL_CALL 1)
set(WAMR_ROOT_DIR ${ROOT}/third_party/wamr)
include(${WAMR_ROOT_DIR}/build-scripts/runtime_lib.cmake)

target_sources(app PRIVATE
    src/main.c
    ${PORT}/fc_port_zephyr.c
    ${PORT}/fc_hw_zephyr.c
    ${PORT}/fc_net_zephyr.c
    ${ROOT}/core/src/fc_log.c
    ${ROOT}/core/src/fc_appapi.c
    ${ROOT}/core/src/fc_arduino.c
    ${ROOT}/core/src/fc_board.c
    ${ROOT}/core/src/fc_metrics.c
    ${ROOT}/core/src/fc_http.c
    ${ROOT}/core/src/fc_mqtt.c
    ${ROOT}/third_party/cjson/cJSON.c
    ${WAMR_RUNTIME_LIB_SOURCE})
if(NOT CONFIG_COMMON_LIBC_MALLOC)
    target_sources(app PRIVATE ${PORT}/fc_heap_zephyr.c)
endif()
target_include_directories(app PRIVATE
    ${ROOT}/core/include ${ROOT}/core/src ${ROOT}/third_party/cjson ${PORT} src)
target_include_directories(app PRIVATE ${ZEPHYR_BINARY_DIR}/include/generated/zephyr)
target_compile_definitions(app PRIVATE CJSON_NESTING_LIMIT=32 FC_LOG_KEEP=1)
set_source_files_properties(${WAMR_RUNTIME_LIB_SOURCE} PROPERTIES
    COMPILE_OPTIONS "-O2"
    COMPILE_DEFINITIONS WASM_ENABLE_COMPACT_DISPATCH=1)
```

## Kconfig
```
# The firmware's options (port/zephyr/Kconfig), which its board files set.
rsource "../../port/zephyr/Kconfig"
```

## prj.conf
```kconfig
# After port/zephyr/prj.conf and its board file, as the firmware is built.
# The floor of heap for the agent, off in the firmware until measured on a
# board with Zephyr: here, its mechanism.
CONFIG_FC_APP_HEAP_CHECK=y
```

## boards/esp32s3_devkitc_procpu.conf
```kconfig
# The app runtime uses the DevKitC's octal PSRAM, as in the firmware.
CONFIG_ESP_SPIRAM=y
CONFIG_SPIRAM_MODE_OCT=y
CONFIG_ESP_SPIRAM_HEAP_SIZE=2097152
# Zephyr allocates the WASM thread stack from the kernel heap.
CONFIG_HEAP_MEM_POOL_SIZE=65536
CONFIG_FC_HEAP_SIZE=120112
# The fixture loads the firmware's board overlay, including its I2C bus,
# SPI bus and SPI-driven LED strip.
CONFIG_I2C=y
CONFIG_SPI=y
CONFIG_LED_STRIP=y
```

## boards/esp32s3_devkitc_procpu.overlay
```dts
/ {
	fc-hw {
		compatible = "flightctl,app-hw";
		button {
			gpios = <&gpio0 5 GPIO_ACTIVE_LOW>;
		};
	};
};
```

## src/main.c
```c
/*
 * The apps' C library on Zephyr (tests/zephyr-apps): the runtime of the apps
 * (core/src/fc_apps.c) with the real Zephyr port and C library, without the
 * agent or Flight Control. It runs the C library's tests of tests/unit
 * (t_libc, a pointer outside the app's memory, a loop in the library), the
 * example apps that use it (trend, hwcheck), t_printf (%f at its deepest) and
 * the module "arduino" with wasm3-arduino's blink as published, and reports
 * the stack each app's thread has used. Built and run with
 * tests/zephyr-apps.sh. On ESP32-S3 the fixture runs t_button against
 * an external virtual GPIO by its devicetree name and fleet alias.
 */
#include "../../../core/src/fc_apps.c"

#include <zephyr/kernel.h>

#include "fc_log.h"
#include "fc_port_zephyr.h"
#include "../../unit/wasm_vectors.h"
#include "../../unit/arduino_vectors.h"
#include "vectors.h"

void fc_agent_notify_status(void) {}
int fc_agent_busy(void) { return 0; }

/* The registry: the modules by name. */
int fc_oci_fetch_layer(const char *image, const char *arch, const char *layer_type, size_t max_size,
                       unsigned char **out, size_t *out_len, char *digest, size_t digest_len, char *err,
                       size_t err_len)
{
    static const struct {
        const char *image;
        const unsigned char *code;
        size_t len;
    } reg[] = {
#define V(n) {"reg/" #n, w_##n, sizeof(w_##n)}
        V(t_button), V(t_state), V(t_libc), V(t_libcoob_1), V(t_libcoob_2), V(t_libcoob_3), V(t_libcoob_4), V(t_libcoob_5),
        V(t_libcloop), V(app_trend), V(app_hwcheck), V(t_printf), V(t_arduino), V(arduino_rust), V(arduino_cpp),
        V(arduino_assemblyscript), V(arduino_tinygo),
#undef V
    };
    for (size_t i = 0; i < sizeof(reg) / sizeof(reg[0]); i++) {
        if (strcmp(image, reg[i].image) == 0) {
            *out = malloc(reg[i].len);
            if (*out == NULL) {
                snprintf(err, err_len, "no memory");
                return -1;
            }
            memcpy(*out, reg[i].code, reg[i].len);
            *out_len = reg[i].len;
            snprintf(digest, digest_len, "sha256:%s", image);
            return 0;
        }
    }
    snprintf(err, err_len, "%s: not found", image);
    return -1;
}

/* The board's own hardware, with a die_temp that rises 0.3 C a read, for
 * trend (the Zephyr port has no chip sensor yet). */
static int32_t s_temp = 40000;
static int fake_sensor(const char *name, int32_t *v)
{
    if (strcmp(name, "die_temp") != 0) {
        return -1;
    }
    *v = __atomic_add_fetch(&s_temp, 300, __ATOMIC_RELAXED);
    return 0;
}

/* led0, counted: how often it was lit and turned off. */
static int s_led_on, s_led_off;
static int fake_led_open(const fc_hw_led_t *l)
{
    return 0;
}
static int fake_led_rgb(const fc_hw_led_t *l, uint8_t r, uint8_t g, uint8_t b)
{
    __atomic_add_fetch(r || g || b ? &s_led_on : &s_led_off, 1, __ATOMIC_RELAXED);
    return 0;
}

static int s_fails;
#define CHECK(c)                                                                                                       \
    do {                                                                                                               \
        if (!(c)) {                                                                                                    \
            printk("FAIL %s:%d: %s\n", __FILE__, __LINE__, #c);                                                        \
            s_fails++;                                                                                                 \
        }                                                                                                              \
    } while (0)

static int apply_one(const char *name, const char *image, const char *env)
{
    cJSON *list = cJSON_CreateArray();
    if (name != NULL) {
        cJSON *a = cJSON_CreateObject();
        cJSON_AddStringToObject(a, "name", name);
        cJSON_AddStringToObject(a, "appType", "container");
        cJSON_AddStringToObject(a, "image", image);
        if (env != NULL) {
            cJSON_AddItemToObject(a, "envVars", cJSON_Parse(env));
        }
        cJSON_AddItemToArray(list, a);
    }
    char err[160] = "";
    int retry;
    int rc = fc_apps_apply(list, err, sizeof(err), &retry);
    cJSON_Delete(list);
    if (rc != 0) {
        printk("apply %s: %s\n", image ? image : "(none)", err);
    }
    return rc;
}

/* "status state-or-error" of the app, or "none". */
static const char *state_of(const char *name)
{
    static char out[200];
    pthread_mutex_lock(&s_lock);
    app_t *a = find(name);
    snprintf(out, sizeof(out), "%s %s", a ? a->status : "none", a ? (a->error[0] ? a->error : a->state) : "");
    pthread_mutex_unlock(&s_lock);
    return out;
}

static const char *wait_state(const char *name, const char *prefix, int ms)
{
    for (int i = 0; i < ms / 20 && strncmp(state_of(name), prefix, strlen(prefix)) != 0; i++) {
        k_msleep(20);
    }
    return state_of(name);
}

/* The least stack the app's thread has had unused, as the device reports it
 * (fc_port_stack_unused, read once a second on the thread). */
static long stack_unused(const char *name)
{
    pthread_mutex_lock(&s_lock);
    app_t *a = find(name);
    long n = a ? __atomic_load_n(&a->stack_unused, __ATOMIC_RELAXED) : -2;
    pthread_mutex_unlock(&s_lock);
    return n;
}

/* Whether the device's log since `from` has this whole line. */
static int log_has(uint32_t from, const char *line)
{
    fc_log_entry_t e;
    uint32_t seq = from;
    while (fc_log_next(&seq, &e) == 0) {
        if (strstr(e.text, line) != NULL) {
            return 1;
        }
    }
    return 0;
}

static void show_log(uint32_t from, const char *app)
{
    fc_log_entry_t e;
    uint32_t seq = from;
    char tag[24];
    snprintf(tag, sizeof(tag), "app %s:", app);
    while (fc_log_next(&seq, &e) == 0) {
        if (strstr(e.text, tag) != NULL) {
            printk("  log: %s\n", e.text);
        }
    }
}

/* Runs one app until its state starts with `want`, then a little over a
 * second more so that its thread has read its stack after the C library's
 * work; reports what it used of THREAD_STACK. */
static void run(const char *name, const char *image, const char *env, const char *want)
{
    uint32_t from = fc_log_end();
    CHECK(apply_one(name, image, env) == 0);
    const char *st = wait_state(name, want, 5000);
    printk("%s: %s\n", image, st);
    CHECK(strncmp(st, want, strlen(want)) == 0);
    k_msleep(2200);
    long unused = stack_unused(name);
    printk("STACK %s: %ld of %d bytes used (%ld unused)\n", image, unused >= 0 ? (long)THREAD_STACK - unused : -1L,
           THREAD_STACK, unused);
    show_log(from, name);
}

#ifndef CONFIG_COMMON_LIBC_MALLOC
/* A nearly full heap, then many chunks with their own headers: previously
 * the boot low was computed from the two different layouts and wrapped. */
static void check_heap_low(void)
{
    size_t total, now, low;
    long largest = fc_port_heap_largest();
    CHECK(largest > 64);
    if (largest <= 64) {
        return;
    }
    void *large = malloc((size_t)largest - 32);
    CHECK(large != NULL);
    fc_heap_stats(&total, &now, &low);
    size_t previous_low = low;
    free(large);

    void *pieces[32];
    fc_heap_watch(1);
    for (size_t i = 0; i < 32; i++) {
        pieces[i] = malloc(24);
        CHECK(pieces[i] != NULL);
    }
    fc_heap_stats(&total, &now, &low);
    CHECK(low <= previous_low && low <= now);
    long watch = fc_heap_watch(0);
    CHECK(watch >= 0 && (size_t)watch <= now);
    for (size_t i = 0; i < 32; i++) {
        free(pieces[i]);
    }
}
#endif

#ifdef CONFIG_SOC_ESP32S3
/* Run identical bytecode twice with the rendered fleet files and app grants.
 * esp-emu presses and releases the same external button for each name. */
static int button_cycle(const char *name)
{
    char config[64], env[80];
    snprintf(config, sizeof(config), "{\"input\":\"%s\"}", name);
    snprintf(env, sizeof(env), "{\"FC_ALLOW\":\"%s\",\"TICK_MS\":\"50\"}", name);
    CHECK(fc_port_write_file("/etc/fc-app/probe.json", config, strlen(config)) == 0);
    CHECK(apply_one("probe", "reg/t_button", env) == 0);
    const char *states[] = {"Running released", "Running pressed", "Running released"};
    const char *commands[] = {"press", "release"};
    for (int i = 0; i < 3; i++) {
        const char *actual = wait_state("probe", states[i], 30000);
        if (strcmp(actual, states[i]) != 0) {
            printk("BUTTON FAIL %s: expected %s, got %s\n", name, states[i], actual);
            return -1;
        }
        if (i < 2) {
            printk("BUTTON %s %s\n", name, commands[i]);
        }
    }
    return apply_one(NULL, NULL, NULL);
}

static int check_button_names(void)
{
    static fc_hw_t hw;
    CHECK(fc_port_zephyr_init() == 0);
    fc_hw_zephyr_fill(&hw);
    fc_apps_set_hw(&hw);
    CHECK(fc_apps_init() == 0);
    CHECK(button_cycle("button") == 0);
    const char *map = "{\"gpio\":{\"fleet-button\":{\"dt\":\"button\"}}}";
    char err[160] = "";
    if (fc_apps_check_file(FC_BOARD_PATH, map, err, sizeof(err)) != 0) {
        printk("BUTTON FAIL %s\n", err);
        return -1;
    }
    CHECK(fc_port_write_file(FC_BOARD_PATH, map, strlen(map)) == 0);
    fc_apps_file_changed(FC_BOARD_PATH);
    CHECK(button_cycle("fleet-button") == 0);
    printk("BUTTON %s\n", s_fails ? "FAIL" : "PASS");
    return s_fails ? -1 : 0;
}
#endif

int main(void)
{
#ifdef CONFIG_SOC_ESP32S3
    return check_button_names();
#endif
    static fc_hw_t hw;
    CHECK(fc_port_zephyr_init() == 0);
#ifndef CONFIG_COMMON_LIBC_MALLOC
    check_heap_low();
#endif
    fc_hw_zephyr_fill(&hw);
    hw.sensor_read = fake_sensor;
    hw.led_open = fake_led_open;
    hw.led_rgb = fake_led_rgb;
    fc_apps_set_hw(&hw);
    CHECK(fc_apps_init() == 0);
    apply_one(NULL, NULL, NULL); /* none left from a previous run in the flash */

    /* No C library: the thread's baseline. */
    run("s", "reg/t_state", NULL, "Running");
    CHECK(apply_one(NULL, NULL, NULL) == 0);

    /* tests/unit's test_libc. */
    uint32_t from = fc_log_end();
    run("l", "reg/t_libc", NULL, "Running copied 7 -42 255 ff 3.14 xyz 0 A bad=0");
    CHECK(log_has(from, "app l: hello"));
    CHECK(log_has(from, "app l: n=5 more"));
    CHECK(log_has(from, "app l: ok"));
    CHECK(log_has(from, "app l: line"));
    CHECK(log_has(from, "app l: partial"));
    CHECK(apply_one(NULL, NULL, NULL) == 0);

    /* %f at its deepest. snprintf takes five arguments, one of them on the
     * stack, where WAMR's invokeNative for Thumb left the stack 4 bytes off
     * the 8 C wants (third_party/patches/wamr-thumb-stack-align.patch): a
     * double was then read from the wrong place. */
    from = fc_log_end();
    run("f", "reg/t_printf", NULL, "Running 3.14 -0.0 42");
    CHECK(log_has(from, "app f: f 3.141593 -0.000         3.1415926536 3.1     |"));
    CHECK(log_has(from, "app f: p 3|3.1|3.14|3.142|3.1416|3.14159|3.141593|3.1415927"));
    CHECK(log_has(from, "app f: q 1.00|2.50|0.12|100.00|3.14"));
    CHECK(log_has(from, "app f: d -1 -2147483647 4000000000 beef 000000ff str z"));
    CHECK(apply_one(NULL, NULL, NULL) == 0);

    /* The example apps. The heap the agent keeps (CONFIG_FC_APP_HEAP_CHECK):
     * what the instance left, and the lowest after it, are logged. */
    from = fc_log_end();
    run("trend", "reg/app_trend", NULL, "Running rising");
    CHECK(log_has(from, "app trend: instance made"));
    for (int i = 0; i < 100 && !log_has(from, "app trend (install): "); i++) {
        k_msleep(50);
    }
    CHECK(log_has(from, "app trend (install): "));
    char heap[96];
    CHECK(fc_apps_heap_agent(heap, sizeof(heap)) == 1);
    printk("heapAgentBytes %s\n", heap);
    CHECK(apply_one(NULL, NULL, NULL) == 0);
    /* With less heap than the floor, the app is refused. */
    long floor = s_heap_floor;
    s_heap_floor = fc_port_heap_free() + 1024;
    CHECK(apply_one("trend", "reg/app_trend", NULL) != 0 || strncmp(wait_state("trend", "Error", 3000), "Error", 5) == 0);
    printk("floor above the heap: %s\n", state_of("trend"));
    s_heap_floor = floor;
    apply_one(NULL, NULL, NULL);
    run("hw", "reg/app_hwcheck", "{\"FC_ALLOW\": \"i2c0 spi0 uart0 adc0 pwm0\", \"TICK_MS\": \"100\"}", "Running i2c");
    CHECK(apply_one(NULL, NULL, NULL) == 0);

    /* A pointer outside the app's memory stops it, as a trap does; so does
     * abort (t_libcoob_5). */
    static const char *const oob[] = {"reg/t_libcoob_1", "reg/t_libcoob_2", "reg/t_libcoob_3", "reg/t_libcoob_4",
                                      "reg/t_libcoob_5"};
    for (size_t i = 0; i < sizeof(oob) / sizeof(oob[0]); i++) {
        CHECK(apply_one("o", oob[i], NULL) == 0);
        const char *st = wait_state("o", "Error", 3000);
        printk("%s: %s\n", oob[i], st);
        CHECK(strncmp(st, "Error", 5) == 0);
        CHECK(apply_one(NULL, NULL, NULL) == 0);
    }

    /* A loop in the C library is stopped after a second. On native_sim the
     * simulated clock stands still while the host runs memset, so there the
     * instruction budget stops it instead. */
    int64_t t0 = fc_apps_now_ms();
    CHECK(apply_one("p", "reg/t_libcloop", NULL) == 0);
    const char *st = wait_state("p", "Error", 8000);
    printk("t_libcloop: %s after %lld ms\n", st, (long long)(fc_apps_now_ms() - t0));
    CHECK(strstr(st, IS_ENABLED(CONFIG_ARCH_POSIX) ? "instruction limit" : "more than 1 s") != NULL);
    CHECK(apply_one(NULL, NULL, NULL) == 0);

    /* The module "arduino": a delay past one of fc's waits, the greeting,
     * print, getPinLED (pin 1, led0), a pin with no such name (pin 0). */
    from = fc_log_end();
    run("a", "reg/t_arduino", "{\"FC_ENTRY\": \"run\", \"FC_ALLOW\": \"nosuch led0\"}", "Completed run() returned 63");
    CHECK(log_has(from, "app a: greeting: Hello from Flight Control"));
    CHECK(apply_one(NULL, NULL, NULL) == 0);
    /* wasm3-arduino's blink, its four builds as published: led0 on and off
     * again, until the app is removed. */
    static const char *const blinks[] = {"reg/arduino_rust", "reg/arduino_cpp", "reg/arduino_assemblyscript",
                                         "reg/arduino_tinygo"};
    for (size_t i = 0; i < sizeof(blinks) / sizeof(blinks[0]); i++) {
        __atomic_store_n(&s_led_on, 0, __ATOMIC_RELAXED);
        __atomic_store_n(&s_led_off, 0, __ATOMIC_RELAXED);
        from = fc_log_end();
        CHECK(apply_one("b", blinks[i], "{\"FC_ALLOW\": \"led0\"}") == 0);
        for (int j = 0; j < 1500 && (__atomic_load_n(&s_led_on, __ATOMIC_RELAXED) < 2 ||
                                     __atomic_load_n(&s_led_off, __ATOMIC_RELAXED) < 2); j++) {
            k_msleep(20);
        }
        int on = __atomic_load_n(&s_led_on, __ATOMIC_RELAXED), off = __atomic_load_n(&s_led_off, __ATOMIC_RELAXED);
        printk("%s: %s, led0 on %d off %d\n", blinks[i], state_of("b"), on, off);
        CHECK(on >= 2 && off >= 2);
        CHECK(strcmp(state_of("b"), "Running ") == 0);
        show_log(from, "b");
        t0 = fc_apps_now_ms();
        CHECK(apply_one(NULL, NULL, NULL) == 0);
        printk("%s: removed in %lld ms\n", blinks[i], (long long)(fc_apps_now_ms() - t0));
        CHECK(fc_apps_now_ms() - t0 < 5000);
    }

    if (s_fails == 0) {
        printk("PASS\n");
    } else {
        printk("FAIL %d\n", s_fails);
    }
#ifdef CONFIG_ARCH_POSIX
    extern void nsi_exit(int code);
    nsi_exit(s_fails != 0);
#endif
    return 0;
}
```

## src/vectors.h
```c
/* Generated by tests/zephyr-apps/gen-vectors.sh from tests/zephyr-apps/wasm/: do not edit. */
#pragma once
static const unsigned char w_t_button[] = {
    0x00, 0x61, 0x73, 0x6d, 0x01, 0x00, 0x00, 0x00, 0x01, 0x21, 0x06, 0x60, 0x04, 0x7f, 0x7f, 0x7f,
    0x7f, 0x01, 0x7f, 0x60, 0x03, 0x7f, 0x7f, 0x7f, 0x01, 0x7f, 0x60, 0x01, 0x7f, 0x01, 0x7f, 0x60,
    0x02, 0x7f, 0x7f, 0x00, 0x60, 0x00, 0x01, 0x7f, 0x60, 0x00, 0x00, 0x02, 0x3e, 0x04, 0x02, 0x66,
    0x63, 0x0a, 0x63, 0x6f, 0x6e, 0x66, 0x69, 0x67, 0x5f, 0x67, 0x65, 0x74, 0x00, 0x00, 0x02, 0x66,
    0x63, 0x09, 0x67, 0x70, 0x69, 0x6f, 0x5f, 0x6f, 0x70, 0x65, 0x6e, 0x00, 0x01, 0x02, 0x66, 0x63,
    0x09, 0x67, 0x70, 0x69, 0x6f, 0x5f, 0x72, 0x65, 0x61, 0x64, 0x00, 0x02, 0x02, 0x66, 0x63, 0x09,
    0x73, 0x65, 0x74, 0x5f, 0x73, 0x74, 0x61, 0x74, 0x65, 0x00, 0x03, 0x03, 0x04, 0x03, 0x04, 0x04,
    0x05, 0x04, 0x05, 0x01, 0x70, 0x01, 0x01, 0x01, 0x05, 0x04, 0x01, 0x01, 0x01, 0x01, 0x06, 0x13,
    0x03, 0x7f, 0x01, 0x41, 0x80, 0x08, 0x0b, 0x7f, 0x00, 0x41, 0xa8, 0x08, 0x0b, 0x7f, 0x00, 0x41,
    0xb0, 0x08, 0x0b, 0x07, 0x44, 0x06, 0x06, 0x6d, 0x65, 0x6d, 0x6f, 0x72, 0x79, 0x02, 0x00, 0x0e,
    0x66, 0x63, 0x5f, 0x61, 0x62, 0x69, 0x5f, 0x76, 0x65, 0x72, 0x73, 0x69, 0x6f, 0x6e, 0x00, 0x04,
    0x04, 0x69, 0x6e, 0x69, 0x74, 0x00, 0x05, 0x04, 0x74, 0x69, 0x63, 0x6b, 0x00, 0x06, 0x0a, 0x5f,
    0x5f, 0x64, 0x61, 0x74, 0x61, 0x5f, 0x65, 0x6e, 0x64, 0x03, 0x01, 0x0b, 0x5f, 0x5f, 0x68, 0x65,
    0x61, 0x70, 0x5f, 0x62, 0x61, 0x73, 0x65, 0x03, 0x02, 0x0a, 0xb6, 0x01, 0x03, 0x04, 0x00, 0x41,
    0x01, 0x0b, 0x63, 0x01, 0x03, 0x7f, 0x23, 0x80, 0x80, 0x80, 0x80, 0x00, 0x41, 0x20, 0x6b, 0x22,
    0x00, 0x24, 0x80, 0x80, 0x80, 0x80, 0x00, 0x41, 0x01, 0x21, 0x01, 0x02, 0x40, 0x41, 0x80, 0x88,
    0x80, 0x80, 0x00, 0x41, 0x05, 0x20, 0x00, 0x41, 0x20, 0x10, 0x80, 0x80, 0x80, 0x80, 0x00, 0x22,
    0x02, 0x41, 0x5f, 0x6a, 0x41, 0x60, 0x49, 0x0d, 0x00, 0x41, 0x00, 0x20, 0x00, 0x20, 0x02, 0x41,
    0x01, 0x10, 0x81, 0x80, 0x80, 0x80, 0x00, 0x22, 0x01, 0x36, 0x02, 0xa4, 0x88, 0x80, 0x80, 0x00,
    0x20, 0x01, 0x41, 0x1f, 0x76, 0x21, 0x01, 0x0b, 0x20, 0x00, 0x41, 0x20, 0x6a, 0x24, 0x80, 0x80,
    0x80, 0x80, 0x00, 0x20, 0x01, 0x0b, 0x4b, 0x00, 0x02, 0x40, 0x02, 0x40, 0x02, 0x40, 0x41, 0x00,
    0x28, 0x02, 0xa4, 0x88, 0x80, 0x80, 0x00, 0x10, 0x82, 0x80, 0x80, 0x80, 0x00, 0x0e, 0x02, 0x00,
    0x01, 0x02, 0x0b, 0x41, 0x99, 0x88, 0x80, 0x80, 0x00, 0x41, 0x08, 0x10, 0x83, 0x80, 0x80, 0x80,
    0x00, 0x0f, 0x0b, 0x41, 0x91, 0x88, 0x80, 0x80, 0x00, 0x41, 0x07, 0x10, 0x83, 0x80, 0x80, 0x80,
    0x00, 0x0f, 0x0b, 0x41, 0x86, 0x88, 0x80, 0x80, 0x00, 0x41, 0x0a, 0x10, 0x83, 0x80, 0x80, 0x80,
    0x00, 0x0b, 0x0b, 0x29, 0x01, 0x00, 0x41, 0x80, 0x08, 0x0b, 0x22, 0x69, 0x6e, 0x70, 0x75, 0x74,
    0x00, 0x72, 0x65, 0x61, 0x64, 0x20, 0x65, 0x72, 0x72, 0x6f, 0x72, 0x00, 0x70, 0x72, 0x65, 0x73,
    0x73, 0x65, 0x64, 0x00, 0x72, 0x65, 0x6c, 0x65, 0x61, 0x73, 0x65, 0x64, 0x00,
};
static const unsigned char w_t_printf[] = {
    0x00, 0x61, 0x73, 0x6d, 0x01, 0x00, 0x00, 0x00, 0x01, 0x1b, 0x05, 0x60, 0x02, 0x7f, 0x7f, 0x01,
    0x7f, 0x60, 0x04, 0x7f, 0x7f, 0x7f, 0x7f, 0x01, 0x7f, 0x60, 0x02, 0x7f, 0x7f, 0x00, 0x60, 0x00,
    0x01, 0x7f, 0x60, 0x00, 0x00, 0x02, 0x2c, 0x03, 0x03, 0x65, 0x6e, 0x76, 0x06, 0x70, 0x72, 0x69,
    0x6e, 0x74, 0x66, 0x00, 0x00, 0x03, 0x65, 0x6e, 0x76, 0x08, 0x73, 0x6e, 0x70, 0x72, 0x69, 0x6e,
    0x74, 0x66, 0x00, 0x01, 0x02, 0x66, 0x63, 0x09, 0x73, 0x65, 0x74, 0x5f, 0x73, 0x74, 0x61, 0x74,
    0x65, 0x00, 0x02, 0x03, 0x04, 0x03, 0x03, 0x03, 0x04, 0x04, 0x05, 0x01, 0x70, 0x01, 0x01, 0x01,
    0x05, 0x04, 0x01, 0x01, 0x01, 0x01, 0x06, 0x13, 0x03, 0x7f, 0x01, 0x41, 0x80, 0x08, 0x0b, 0x7f,
    0x00, 0x41, 0x96, 0x09, 0x0b, 0x7f, 0x00, 0x41, 0xa0, 0x09, 0x0b, 0x07, 0x44, 0x06, 0x06, 0x6d,
    0x65, 0x6d, 0x6f, 0x72, 0x79, 0x02, 0x00, 0x0e, 0x66, 0x63, 0x5f, 0x61, 0x62, 0x69, 0x5f, 0x76,
    0x65, 0x72, 0x73, 0x69, 0x6f, 0x6e, 0x00, 0x03, 0x04, 0x69, 0x6e, 0x69, 0x74, 0x00, 0x04, 0x04,
    0x74, 0x69, 0x63, 0x6b, 0x00, 0x05, 0x0a, 0x5f, 0x5f, 0x64, 0x61, 0x74, 0x61, 0x5f, 0x65, 0x6e,
    0x64, 0x03, 0x01, 0x0b, 0x5f, 0x5f, 0x68, 0x65, 0x61, 0x70, 0x5f, 0x62, 0x61, 0x73, 0x65, 0x03,
    0x02, 0x0a, 0x8a, 0x05, 0x03, 0x04, 0x00, 0x41, 0x01, 0x0b, 0xff, 0x04, 0x02, 0x01, 0x7f, 0x02,
    0x7c, 0x23, 0x80, 0x80, 0x80, 0x80, 0x00, 0x41, 0xc0, 0x02, 0x6b, 0x22, 0x00, 0x24, 0x80, 0x80,
    0x80, 0x80, 0x00, 0x20, 0x00, 0x42, 0x91, 0xda, 0x90, 0xa2, 0xb5, 0xbf, 0xc8, 0x84, 0xc0, 0x00,
    0x37, 0x03, 0xb8, 0x02, 0x20, 0x00, 0x42, 0xc6, 0xa4, 0xbb, 0xa3, 0x9f, 0xe6, 0x87, 0x90, 0xbf,
    0x7f, 0x37, 0x03, 0xb0, 0x02, 0x20, 0x00, 0x42, 0x9c, 0xeb, 0x81, 0xc0, 0xc8, 0x87, 0xf9, 0x9b,
    0xfe, 0x00, 0x37, 0x03, 0xa8, 0x02, 0x20, 0x00, 0x41, 0x81, 0x80, 0x80, 0x80, 0x78, 0x36, 0x02,
    0xa4, 0x02, 0x20, 0x00, 0x2b, 0x03, 0xb8, 0x02, 0x21, 0x01, 0x20, 0x00, 0x2b, 0x03, 0xb0, 0x02,
    0x21, 0x02, 0x20, 0x00, 0x41, 0xc0, 0x01, 0x6a, 0x41, 0x10, 0x6a, 0x20, 0x00, 0x2b, 0x03, 0xb8,
    0x02, 0x39, 0x03, 0x00, 0x20, 0x00, 0x41, 0xc0, 0x01, 0x6a, 0x41, 0x18, 0x6a, 0x20, 0x00, 0x2b,
    0x03, 0xb8, 0x02, 0x39, 0x03, 0x00, 0x20, 0x00, 0x20, 0x01, 0x39, 0x03, 0xc0, 0x01, 0x20, 0x00,
    0x20, 0x02, 0x39, 0x03, 0xc8, 0x01, 0x41, 0x91, 0x88, 0x80, 0x80, 0x00, 0x20, 0x00, 0x41, 0xc0,
    0x01, 0x6a, 0x10, 0x80, 0x80, 0x80, 0x80, 0x00, 0x1a, 0x20, 0x00, 0x20, 0x00, 0x2b, 0x03, 0xa8,
    0x02, 0x39, 0x03, 0xb0, 0x01, 0x41, 0xf3, 0x88, 0x80, 0x80, 0x00, 0x20, 0x00, 0x41, 0xb0, 0x01,
    0x6a, 0x10, 0x80, 0x80, 0x80, 0x80, 0x00, 0x1a, 0x20, 0x00, 0x2b, 0x03, 0xb8, 0x02, 0x21, 0x01,
    0x20, 0x00, 0x2b, 0x03, 0xb8, 0x02, 0x21, 0x02, 0x20, 0x00, 0x41, 0xf0, 0x00, 0x6a, 0x41, 0x10,
    0x6a, 0x20, 0x00, 0x2b, 0x03, 0xb8, 0x02, 0x39, 0x03, 0x00, 0x20, 0x00, 0x41, 0xf0, 0x00, 0x6a,
    0x41, 0x18, 0x6a, 0x20, 0x00, 0x2b, 0x03, 0xb8, 0x02, 0x39, 0x03, 0x00, 0x20, 0x00, 0x41, 0xf0,
    0x00, 0x6a, 0x41, 0x20, 0x6a, 0x20, 0x00, 0x2b, 0x03, 0xb8, 0x02, 0x39, 0x03, 0x00, 0x20, 0x00,
    0x41, 0x98, 0x01, 0x6a, 0x20, 0x00, 0x2b, 0x03, 0xb8, 0x02, 0x39, 0x03, 0x00, 0x20, 0x00, 0x41,
    0xa0, 0x01, 0x6a, 0x20, 0x00, 0x2b, 0x03, 0xb8, 0x02, 0x39, 0x03, 0x00, 0x20, 0x00, 0x41, 0xa8,
    0x01, 0x6a, 0x20, 0x00, 0x2b, 0x03, 0xb8, 0x02, 0x39, 0x03, 0x00, 0x20, 0x00, 0x20, 0x01, 0x39,
    0x03, 0x70, 0x20, 0x00, 0x20, 0x02, 0x39, 0x03, 0x78, 0x41, 0xac, 0x88, 0x80, 0x80, 0x00, 0x20,
    0x00, 0x41, 0xf0, 0x00, 0x6a, 0x10, 0x80, 0x80, 0x80, 0x80, 0x00, 0x1a, 0x20, 0x00, 0x41, 0xc0,
    0x00, 0x6a, 0x41, 0x20, 0x6a, 0x42, 0x9f, 0x8a, 0xae, 0x8f, 0x85, 0xd7, 0xc7, 0x84, 0xc0, 0x00,
    0x37, 0x03, 0x00, 0x20, 0x00, 0x41, 0xc0, 0x00, 0x6a, 0x41, 0x18, 0x6a, 0x42, 0x80, 0x80, 0x80,
    0x80, 0x80, 0x80, 0xc0, 0xac, 0xc0, 0x00, 0x37, 0x03, 0x00, 0x20, 0x00, 0x41, 0xc0, 0x00, 0x6a,
    0x41, 0x10, 0x6a, 0x42, 0x80, 0x80, 0x80, 0x80, 0x80, 0x80, 0x80, 0xe0, 0x3f, 0x37, 0x03, 0x00,
    0x20, 0x00, 0x42, 0x80, 0x80, 0x80, 0x80, 0x80, 0x80, 0x80, 0x82, 0xc0, 0x00, 0x37, 0x03, 0x48,
    0x20, 0x00, 0x42, 0x80, 0x80, 0x80, 0x80, 0x80, 0x80, 0x80, 0xf8, 0x3f, 0x37, 0x03, 0x40, 0x41,
    0xd7, 0x88, 0x80, 0x80, 0x00, 0x20, 0x00, 0x41, 0xc0, 0x00, 0x6a, 0x10, 0x80, 0x80, 0x80, 0x80,
    0x00, 0x1a, 0x20, 0x00, 0x41, 0x34, 0x6a, 0x41, 0x80, 0x88, 0x80, 0x80, 0x00, 0x36, 0x02, 0x00,
    0x20, 0x00, 0x41, 0x20, 0x6a, 0x41, 0x18, 0x6a, 0x41, 0xfa, 0x00, 0x36, 0x02, 0x00, 0x20, 0x00,
    0x41, 0x7f, 0x36, 0x02, 0x20, 0x20, 0x00, 0x41, 0x80, 0xd0, 0xac, 0xf3, 0x7e, 0x36, 0x02, 0x28,
    0x20, 0x00, 0x42, 0xef, 0xfd, 0x82, 0x80, 0xf0, 0x1f, 0x37, 0x02, 0x2c, 0x20, 0x00, 0x20, 0x00,
    0x28, 0x02, 0xa4, 0x02, 0x36, 0x02, 0x24, 0x41, 0xfb, 0x88, 0x80, 0x80, 0x00, 0x20, 0x00, 0x41,
    0x20, 0x6a, 0x10, 0x80, 0x80, 0x80, 0x80, 0x00, 0x1a, 0x20, 0x00, 0x41, 0x10, 0x6a, 0x41, 0x2a,
    0x36, 0x02, 0x00, 0x20, 0x00, 0x20, 0x00, 0x2b, 0x03, 0xb8, 0x02, 0x39, 0x03, 0x00, 0x20, 0x00,
    0x20, 0x00, 0x2b, 0x03, 0xb0, 0x02, 0x39, 0x03, 0x08, 0x20, 0x00, 0x41, 0xe0, 0x01, 0x6a, 0x20,
    0x00, 0x41, 0xe0, 0x01, 0x6a, 0x41, 0xc0, 0x00, 0x41, 0x84, 0x88, 0x80, 0x80, 0x00, 0x20, 0x00,
    0x10, 0x81, 0x80, 0x80, 0x80, 0x00, 0x10, 0x82, 0x80, 0x80, 0x80, 0x00, 0x20, 0x00, 0x41, 0xc0,
    0x02, 0x6a, 0x24, 0x80, 0x80, 0x80, 0x80, 0x00, 0x41, 0x00, 0x0b, 0x02, 0x00, 0x0b, 0x0b, 0x9e,
    0x01, 0x01, 0x00, 0x41, 0x80, 0x08, 0x0b, 0x96, 0x01, 0x73, 0x74, 0x72, 0x00, 0x25, 0x2e, 0x32,
    0x66, 0x20, 0x25, 0x2e, 0x31, 0x66, 0x20, 0x25, 0x64, 0x00, 0x66, 0x20, 0x25, 0x66, 0x20, 0x25,
    0x2e, 0x33, 0x66, 0x20, 0x25, 0x32, 0x30, 0x2e, 0x31, 0x30, 0x66, 0x20, 0x25, 0x2d, 0x38, 0x2e,
    0x31, 0x66, 0x7c, 0x0a, 0x00, 0x70, 0x20, 0x25, 0x2e, 0x30, 0x66, 0x7c, 0x25, 0x2e, 0x31, 0x66,
    0x7c, 0x25, 0x2e, 0x32, 0x66, 0x7c, 0x25, 0x2e, 0x33, 0x66, 0x7c, 0x25, 0x2e, 0x34, 0x66, 0x7c,
    0x25, 0x2e, 0x35, 0x66, 0x7c, 0x25, 0x2e, 0x36, 0x66, 0x7c, 0x25, 0x2e, 0x37, 0x66, 0x0a, 0x00,
    0x71, 0x20, 0x25, 0x2e, 0x32, 0x66, 0x7c, 0x25, 0x2e, 0x32, 0x66, 0x7c, 0x25, 0x2e, 0x32, 0x66,
    0x7c, 0x25, 0x2e, 0x32, 0x66, 0x7c, 0x25, 0x2e, 0x32, 0x66, 0x0a, 0x00, 0x62, 0x69, 0x67, 0x20,
    0x25, 0x66, 0x0a, 0x00, 0x64, 0x20, 0x25, 0x64, 0x20, 0x25, 0x6c, 0x64, 0x20, 0x25, 0x75, 0x20,
    0x25, 0x78, 0x20, 0x25, 0x30, 0x38, 0x78, 0x20, 0x25, 0x73, 0x20, 0x25, 0x63, 0x0a, 0x00,
};
```
